## CMakeLists.txt
```
# SPDX-License-Identifier: Apache-2.0

cmake_minimum_required(VERSION 3.20.0)
find_package(Zephyr REQUIRED HINTS $ENV{ZEPHYR_BASE})
project(wav)

file(GLOB app_sources src/*.c)
target_sources(app PRIVATE ${app_sources})
```

## prj.conf
```kconfig
CONFIG_ZTEST=y
CONFIG_WAV=y
```

## overlay-fs.conf
```kconfig
# Adds the CONFIG_WAV_FS byte source, and the littlefs instance the equivalence
# test writes its containers to.

CONFIG_WAV_FS=y

CONFIG_FILE_SYSTEM=y
CONFIG_FILE_SYSTEM_MKFS=y
CONFIG_FILE_SYSTEM_LITTLEFS=y

CONFIG_FLASH=y
CONFIG_FLASH_MAP=y

# littlefs is stack hungry, and the equivalence test keeps two parsers alive.
CONFIG_MAIN_STACK_SIZE=4096
CONFIG_ZTEST_STACK_SIZE=4096
```

## src/main.c
```c
/*
 * Copyright (c) 2026 Ugo Marchand
 *
 * SPDX-License-Identifier: Apache-2.0
 */

#include <errno.h>
#include <string.h>

#include <zephyr/audio/wav.h>
#include <zephyr/sys/byteorder.h>
#include <zephyr/sys/util.h>
#include <zephyr/ztest.h>

#include "fixtures.h"

/**
 * @brief A byte source that fails the test if the parser reads outside it.
 *
 * wav_parse() is fed untrusted bytes, so the interesting property is not what it returns but
 * where it reads. Every call is checked here, which turns an out-of-bounds read into a test
 * failure instead of something that happens to work on this platform.
 */
struct checked_source {
	const uint8_t *buf;
	uint32_t size;
	/** Number of times the callback has been invoked. */
	unsigned int calls;
	/** Largest read that is legitimate for what is being tested. */
	size_t max_read;
	/** Call number to fail on, counting from one. Zero never fails. */
	unsigned int fail_at;
	/** What to fail with. */
	int fail_ret;
};

static int checked_read(void *user_data, uint32_t off, void *dst, size_t len)
{
	struct checked_source *cs = user_data;

	cs->calls++;

	zassert_true(off <= cs->size, "read at +%u of a %u byte source", off, cs->size);
	zassert_true(len <= (size_t)(cs->size - off), "read of %zu B at +%u runs past %u B", len,
		     off, cs->size);
	zassert_true(len <= cs->max_read, "read of %zu B exceeds the documented maximum %zu", len,
		     cs->max_read);

	if ((cs->fail_at != 0U) && (cs->calls == cs->fail_at)) {
		return cs->fail_ret;
	}

	memcpy(dst, &cs->buf[off], len);

	return 0;
}

static void checked_source_init(struct wav_source *src, struct checked_source *cs,
				const uint8_t *buf, size_t size)
{
	*cs = (struct checked_source){
		.buf = buf,
		.size = (uint32_t)size,
		.max_read = WAV_SOURCE_MAX_READ_SIZE,
	};

	*src = (struct wav_source){
		.read = checked_read,
		.user_data = cs,
		.size = (uint32_t)size,
	};
}

/** Parse through the checked source, which is how every container in here is parsed. */
static int parse_checked(const uint8_t *buf, size_t size, struct wav_info *info)
{
	struct checked_source cs;
	struct wav_source src;
	struct wav_info scratch;

	checked_source_init(&src, &cs, buf, size);

	return wav_parse(&src, (info != NULL) ? info : &scratch);
}

/**
 * @brief Assert the invariants wav_parse() promises on success.
 *
 * Notably that the payload lies inside the source, which is what every caller relies on when
 * it hands @c data_off and @c data_len to a DMA controller.
 */
static void assert_info_sane(const struct wav_info *info, uint32_t size)
{
	zassert_not_equal(info->num_channels, 0, "channel count of zero reported");
	zassert_not_equal(info->sample_rate, 0, "sample rate of zero reported");
	zassert_not_equal(info->bits_per_sample, 0, "sample width of zero reported");
	zassert_equal(info->bits_per_sample % 8U, 0, "sample width %u is not whole bytes",
		      info->bits_per_sample);
	zassert_true(info->bits_per_sample <= 64, "sample width %u reported",
		     info->bits_per_sample);
	zassert_not_equal(info->format, WAV_FORMAT_EXTENSIBLE, "extensible left unresolved");
	zassert_true(info->data_off <= size, "payload starts past the source");
	zassert_true(info->data_len <= (size - info->data_off), "payload runs past the source");
	zassert_not_equal(wav_frame_size(info), 0, "frame size of zero reported");
}

ZTEST_SUITE(wav_valid, NULL, NULL, NULL, NULL, NULL);

ZTEST(wav_valid, test_canonical)
{
	struct wav_info info;

	zassert_ok(parse_checked(wav_canonical, sizeof(wav_canonical), &info));
	zassert_equal(info.format, WAV_FORMAT_PCM);
	zassert_equal(info.num_channels, 1);
	zassert_equal(info.sample_rate, 16000);
	zassert_equal(info.bits_per_sample, 16);
	zassert_equal(info.data_off, 44, "the textbook layout does put the payload at 44");
	zassert_equal(info.data_len, 8);
}

ZTEST(wav_valid, test_ffmpeg_metadata_chunk)
{
	struct wav_info info;

	zassert_ok(parse_checked(wav_ffmpeg, sizeof(wav_ffmpeg), &info));
	zassert_equal(info.data_off, 108, "a LIST chunk pushes the payload past offset 44");
	zassert_equal(info.data_len, 8);
	zassert_equal(info.sample_rate, 16000);
}

ZTEST(wav_valid, test_stereo)
{
	struct wav_info info;

	zassert_ok(parse_checked(wav_stereo, sizeof(wav_stereo), &info));
	zassert_equal(info.num_channels, 2);
	zassert_equal(info.sample_rate, 22050);
	zassert_equal(wav_frame_size(&info), 4);
	zassert_equal(wav_frame_count(&info), 2);
}

ZTEST(wav_valid, test_odd_length_chunk_is_padded)
{
	struct wav_info info;

	zassert_ok(parse_checked(wav_odd_pad, sizeof(wav_odd_pad), &info));
	zassert_equal(info.data_off, 56, "the pad byte after an odd chunk was not skipped");
	zassert_equal(info.data_len, 8);
}

ZTEST(wav_valid, test_fmt_chunk_of_18_bytes)
{
	struct wav_info info;

	zassert_ok(parse_checked(wav_fmt18, sizeof(wav_fmt18), &info));
	zassert_equal(info.sample_rate, 44100);
	zassert_equal(info.data_off, 46);
}

ZTEST(wav_valid, test_extensible_resolves_to_pcm)
{
	struct wav_info info;

	zassert_ok(parse_checked(wav_extensible, sizeof(wav_extensible), &info));
	zassert_equal(info.format, WAV_FORMAT_PCM, "the SubFormat GUID was not read");
	zassert_equal(info.num_channels, 6);
	zassert_equal(info.bits_per_sample, 24);
	zassert_equal(wav_frame_size(&info), 18);
	zassert_equal(wav_frame_count(&info), 2);
}

ZTEST(wav_valid, test_uncompressed_formats)
{
	struct wav_info info;

	zassert_ok(parse_checked(wav_float32, sizeof(wav_float32), &info));
	zassert_equal(info.format, WAV_FORMAT_IEEE_FLOAT);
	zassert_equal(info.bits_per_sample, 32);

	zassert_ok(parse_checked(wav_mulaw, sizeof(wav_mulaw), &info));
	zassert_equal(info.format, WAV_FORMAT_MULAW);

	zassert_ok(parse_checked(wav_alaw, sizeof(wav_alaw), &info));
	zassert_equal(info.format, WAV_FORMAT_ALAW);
}

ZTEST(wav_valid, test_data_before_fmt)
{
	struct wav_info info;

	zassert_ok(parse_checked(wav_data_first, sizeof(wav_data_first), &info));
	zassert_equal(info.data_off, 20);
	zassert_equal(info.sample_rate, 16000);
}

ZTEST(wav_valid, test_empty_payload)
{
	struct wav_info info;

	zassert_ok(parse_checked(wav_empty_data, sizeof(wav_empty_data), &info),
		   "a header with no audio behind it is still a valid header");
	zassert_equal(info.data_len, 0);
	zassert_equal(wav_frame_count(&info), 0);
	zassert_equal(wav_duration_ms(&info), 0);
}

ZTEST(wav_valid, test_unbounded_payload_is_clamped)
{
	struct wav_info info;

	zassert_ok(parse_checked(wav_data_unbounded, sizeof(wav_data_unbounded), &info));
	zassert_equal(info.data_len, 8, "a payload size of 0xFFFFFFFF was not clamped");
	zassert_equal(info.data_off + info.data_len, sizeof(wav_data_unbounded));
}

ZTEST(wav_valid, test_walk_stops_at_the_payload)
{
	struct checked_source cs;
	struct wav_source src;
	struct wav_info info;

	checked_source_init(&src, &cs, wav_trailing, sizeof(wav_trailing));

	zassert_ok(wav_parse(&src, &info));
	/* Preamble, then one chunk header each for `fmt ` and `data`, plus the `fmt ` body:
	 * four reads. Anything more means the chunks behind the payload were walked too.
	 */
	zassert_equal(cs.calls, 4, "%u reads, so the walk did not stop at the payload", cs.calls);
}

ZTEST(wav_valid, test_no_output_written_on_failure)
{
	struct wav_info info;

	memset(&info, 0xA5, sizeof(info));

	zassert_equal(parse_checked(wav_adpcm, sizeof(wav_adpcm), &info), -ENOTSUP);

	for (size_t i = 0; i < sizeof(info); i++) {
		zassert_equal(((const uint8_t *)&info)[i], 0xA5,
			      "a failed parse wrote to the caller's struct");
	}
}

ZTEST_SUITE(wav_malformed, NULL, NULL, NULL, NULL, NULL);

ZTEST(wav_malformed, test_too_short)
{
	/* Every prefix of a real container that is shorter than the preamble. */
	for (size_t size = 0; size < WAV_MIN_FILE_SIZE; size++) {
		zassert_equal(parse_checked(wav_canonical, size, NULL), -EINVAL,
			      "a %zu byte source was accepted", size);
	}
}

ZTEST(wav_malformed, test_wrong_container)
{
	zassert_equal(parse_checked(wav_riffx, sizeof(wav_riffx), NULL), -EINVAL,
		      "a big-endian RIFX container was accepted");
	zassert_equal(parse_checked(wav_avi, sizeof(wav_avi), NULL), -EINVAL,
		      "a RIFF container holding AVI was accepted");
}

ZTEST(wav_malformed, test_missing_chunks)
{
	zassert_equal(parse_checked(wav_preamble_only, sizeof(wav_preamble_only), NULL), -ENOENT);
	zassert_equal(parse_checked(wav_no_data, sizeof(wav_no_data), NULL), -ENOENT);
	zassert_equal(parse_checked(wav_no_fmt, sizeof(wav_no_fmt), NULL), -ENOENT);
}

ZTEST(wav_malformed, test_truncated_fmt)
{
	zassert_equal(parse_checked(wav_fmt_truncated, sizeof(wav_fmt_truncated), NULL), -EINVAL);
	zassert_equal(parse_checked(wav_extensible_no_guid, sizeof(wav_extensible_no_guid), NULL),
		      -EINVAL, "extensible without its SubFormat GUID was accepted");
}

ZTEST(wav_malformed, test_chunk_size_is_clamped_before_use)
{
	zassert_equal(parse_checked(wav_chunk_unbounded, sizeof(wav_chunk_unbounded), NULL),
		      -ENOENT);
	zassert_equal(parse_checked(wav_size_wraps, sizeof(wav_size_wraps), NULL), -ENOENT,
		      "a chunk size chosen to wrap the offset was not clamped first");
}

ZTEST(wav_malformed, test_unusable_format_fields)
{
	zassert_equal(parse_checked(wav_zero_channels, sizeof(wav_zero_channels), NULL), -EINVAL);
	zassert_equal(parse_checked(wav_zero_rate, sizeof(wav_zero_rate), NULL), -EINVAL);
	zassert_equal(parse_checked(wav_zero_bits, sizeof(wav_zero_bits), NULL), -EINVAL);
	zassert_equal(parse_checked(wav_bits12, sizeof(wav_bits12), NULL), -EINVAL,
		      "12 bits per sample is not a whole number of bytes");
	zassert_equal(parse_checked(wav_bits128, sizeof(wav_bits128), NULL), -EINVAL);
}

ZTEST(wav_malformed, test_formats_that_are_not_flat_frames)
{
	zassert_equal(parse_checked(wav_adpcm, sizeof(wav_adpcm), NULL), -ENOTSUP);
	zassert_equal(parse_checked(wav_mp3, sizeof(wav_mp3), NULL), -ENOTSUP);
	zassert_equal(parse_checked(wav_extensible_adpcm, sizeof(wav_extensible_adpcm), NULL),
		      -ENOTSUP, "a SubFormat GUID naming ADPCM was accepted");
}

ZTEST(wav_malformed, test_null_arguments)
{
	struct checked_source cs;
	struct wav_source src;
	struct wav_info info;

	checked_source_init(&src, &cs, wav_canonical, sizeof(wav_canonical));

	zassert_equal(wav_parse(NULL, &info), -EINVAL);
	zassert_equal(wav_parse(&src, NULL), -EINVAL);

	src.read = NULL;
	zassert_equal(wav_parse(&src, &info), -EINVAL, "a source with no read callback was used");
}

ZTEST(wav_malformed, test_source_errors_are_propagated)
{
	/* Fail on each read in turn. Whichever one it is, the errno has to come back
	 * untouched, and the parser must not have read anywhere it should not.
	 */
	for (unsigned int nth = 1; nth <= 8U; nth++) {
		struct checked_source cs;
		struct wav_source src;
		struct wav_info info;
		int ret;

		checked_source_init(&src, &cs, wav_ffmpeg, sizeof(wav_ffmpeg));
		cs.fail_at = nth;
		cs.fail_ret = -EIO;

		ret = wav_parse(&src, &info);

		if (cs.calls < nth) {
			/* The parse finished before reaching that read. */
			zassert_ok(ret);
			continue;
		}

		zassert_equal(ret, -EIO, "read %u failed with -EIO but wav_parse() returned %d",
			      nth, ret);
	}
}

ZTEST_SUITE(wav_limits, NULL, NULL, NULL, NULL, NULL);

/** Append @p count chunks that hold nothing and mean nothing. */
static size_t append_filler(uint8_t *buf, size_t off, unsigned int count)
{
	for (unsigned int i = 0; i < count; i++) {
		memcpy(&buf[off], "junk", 4);
		sys_put_le32(0U, &buf[off + 4]);
		off += 8U;
	}

	return off;
}

/* Preamble, the fillers, a 16-byte `fmt ` chunk and an empty `data` chunk. */
#define FILLER_BUF_SIZE (WAV_MIN_FILE_SIZE + ((CONFIG_WAV_MAX_CHUNKS + 1) * 8U) + 24U + 8U)

static size_t build_with_filler(uint8_t *buf, unsigned int fillers)
{
	static const uint8_t tail[] = {
		FMT_PCM(1, 16000, 16),
		CHUNK_HEADER('d', 'a', 't', 'a', 0),
	};
	static const uint8_t preamble[] = {RIFF_WAVE(4)};
	size_t off;

	memcpy(buf, preamble, sizeof(preamble));
	off = append_filler(buf, sizeof(preamble), fillers);
	memcpy(&buf[off], tail, sizeof(tail));

	return off + sizeof(tail);
}

ZTEST(wav_limits, test_chunk_list_within_the_limit)
{
	static uint8_t buf[FILLER_BUF_SIZE];
	struct wav_info info;
	size_t size;

	/* Enough fillers that the format and the payload land on the last two allowed
	 * iterations of the walk.
	 */
	size = build_with_filler(buf, CONFIG_WAV_MAX_CHUNKS - 2);

	zassert_ok(parse_checked(buf, size, &info),
		   "a chunk list of exactly the limit was refused");
	zassert_equal(info.sample_rate, 16000);
	zassert_equal(info.data_len, 0);
}

ZTEST(wav_limits, test_chunk_list_over_the_limit)
{
	static uint8_t buf[FILLER_BUF_SIZE];
	size_t size = build_with_filler(buf, CONFIG_WAV_MAX_CHUNKS);

	zassert_equal(parse_checked(buf, size, NULL), -E2BIG,
		      "a chunk list longer than CONFIG_WAV_MAX_CHUNKS did not bound the walk");
}

ZTEST_SUITE(wav_payload, NULL, NULL, NULL, NULL, NULL);

ZTEST(wav_payload, test_read_whole_payload)
{
	struct checked_source cs;
	struct wav_source src;
	struct wav_info info;
	uint8_t dst[16];

	checked_source_init(&src, &cs, wav_ffmpeg, sizeof(wav_ffmpeg));
	zassert_ok(wav_parse(&src, &info));

	cs.max_read = sizeof(dst);

	zassert_equal(wav_read(&src, &info, 0U, dst, sizeof(dst)), 8,
		      "a read longer than the payload was not clamped to it");
	zassert_mem_equal(dst, &wav_ffmpeg[info.data_off], 8, "wrong bytes returned");
}

ZTEST(wav_payload, test_read_in_blocks)
{
	struct checked_source cs;
	struct wav_source src;
	struct wav_info info;
	uint8_t dst[36];
	uint32_t off = 0;

	checked_source_init(&src, &cs, wav_extensible, sizeof(wav_extensible));
	zassert_ok(wav_parse(&src, &info));

	/* Refill in whole frames, the way a playback loop does. */
	while (off < info.data_len) {
		ssize_t ret = wav_read(&src, &info, off, &dst[off], wav_frame_size(&info));

		zassert_true(ret > 0, "wav_read() returned %zd part way through", ret);
		off += (uint32_t)ret;
	}

	zassert_equal(off, info.data_len);
	zassert_mem_equal(dst, &wav_extensible[info.data_off], info.data_len);

	zassert_equal(wav_read(&src, &info, off, dst, sizeof(dst)), 0,
		      "the end of the payload is not an error");
}

ZTEST(wav_payload, test_read_edges)
{
	struct checked_source cs;
	struct wav_source src;
	struct wav_info info;
	uint8_t dst[8];

	checked_source_init(&src, &cs, wav_canonical, sizeof(wav_canonical));
	zassert_ok(wav_parse(&src, &info));

	zassert_equal(wav_read(&src, &info, 0U, dst, 0U), 0, "a zero length read is not an error");
	zassert_equal(wav_read(&src, &info, info.data_len, dst, sizeof(dst)), 0);
	zassert_equal(wav_read(&src, &info, info.data_len + 1U, dst, sizeof(dst)), -EINVAL,
		      "a read starting past the payload was accepted");
	zassert_equal(wav_read(&src, &info, 0U, NULL, sizeof(dst)), -EINVAL);
	zassert_equal(wav_read(NULL, &info, 0U, dst, sizeof(dst)), -EINVAL);
	zassert_equal(wav_read(&src, NULL, 0U, dst, sizeof(dst)), -EINVAL);
}

ZTEST(wav_payload, test_read_errors_are_propagated)
{
	struct checked_source cs;
	struct wav_source src;
	struct wav_info info;
	uint8_t dst[8];

	checked_source_init(&src, &cs, wav_canonical, sizeof(wav_canonical));
	zassert_ok(wav_parse(&src, &info));

	cs.fail_at = cs.calls + 1U;
	cs.fail_ret = -ENOSPC;

	zassert_equal(wav_read(&src, &info, 0U, dst, sizeof(dst)), -ENOSPC,
		      "the source's errno was not passed through");
}

ZTEST_SUITE(wav_helpers, NULL, NULL, NULL, NULL, NULL);

ZTEST(wav_helpers, test_frame_arithmetic)
{
	struct wav_info info = {
		.sample_rate = 48000,
		.num_channels = 6,
		.bits_per_sample = 24,
		.data_len = 18U * 100U,
	};

	zassert_equal(wav_frame_size(&info), 18);
	zassert_equal(wav_frame_count(&info), 100);

	/* A partial trailing frame is not a frame. */
	info.data_len += 7U;
	zassert_equal(wav_frame_count(&info), 100);
}

ZTEST(wav_helpers, test_duration)
{
	struct wav_info info = {
		.sample_rate = 16000,
		.num_channels = 1,
		.bits_per_sample = 16,
		.data_len = 16000U * 2U * 5U,
	};

	zassert_equal(wav_duration_ms(&info), 5000);

	/* Rounded down, not up. */
	info.data_len = 31U * 2U;
	zassert_equal(wav_duration_ms(&info), 1);

	/*
	 * Just over four and a half minutes at this rate is where multiplying the frame count
	 * by a thousand stops fitting in 32 bits. Getting this wrong reports a long recording
	 * as a few milliseconds.
	 */
	info.data_len = 8000000U * 2U;
	zassert_equal(wav_duration_ms(&info), 500000,
		      "the frame count times a thousand overflowed");

	/* The largest payload a 32-bit size can describe, one channel of 8-bit at 8 kHz:
	 * around six days, which still fits in milliseconds.
	 */
	info.sample_rate = 8000;
	info.bits_per_sample = 8;
	info.data_len = UINT32_MAX;
	zassert_equal(wav_duration_ms(&info), 536870911);
}

ZTEST_SUITE(wav_sweep, NULL, NULL, NULL, NULL, NULL);

/** The codes wav_parse() is documented to return when the source itself never fails. */
static void assert_documented(int ret, const char *what)
{
	switch (ret) {
	case 0:
	case -EINVAL:
	case -ENOENT:
	case -ENOTSUP:
	case -E2BIG:
		break;
	default:
		zassert_unreachable("%s: undocumented return %d", what, ret);
	}
}

ZTEST(wav_sweep, test_every_fixture_returns_what_it_should)
{
	ARRAY_FOR_EACH_PTR(wav_fixtures, f) {
		struct wav_info info;
		int ret = parse_checked(f->buf, f->size, &info);

		zassert_equal(ret, f->expected, "%s: expected %d, got %d", f->name, f->expected,
			      ret);

		if (ret == 0) {
			assert_info_sane(&info, (uint32_t)f->size);
		}
	}
}

ZTEST(wav_sweep, test_truncation_at_every_length)
{
	/*
	 * Truncating a container is the failure mode a partial download or a full flash
	 * produces, and every prefix has to come back with a documented error rather than a
	 * read past the end. The checked source is what actually enforces the second half.
	 */
	ARRAY_FOR_EACH_PTR(wav_fixtures, f) {
		for (size_t size = 0; size <= f->size; size++) {
			struct wav_info info;
			int ret = parse_checked(f->buf, size, &info);

			assert_documented(ret, f->name);

			if (ret == 0) {
				assert_info_sane(&info, (uint32_t)size);
			}
		}
	}
}

ZTEST(wav_sweep, test_single_byte_mutations)
{
	/*
	 * A cheap stand-in for a fuzzer: poke each byte in turn with the values that tend to
	 * break length arithmetic, and require only that the parser comes back with something
	 * it documents and never reads outside the buffer.
	 */
	static const uint8_t pokes[] = {0x00, 0x01, 0x7F, 0xFF};
	static uint8_t buf[sizeof(wav_ffmpeg)];

	ARRAY_FOR_EACH(pokes, p) {
		for (size_t i = 0; i < sizeof(buf); i++) {
			struct wav_info info;
			int ret;

			memcpy(buf, wav_ffmpeg, sizeof(buf));
			buf[i] = pokes[p];

			ret = parse_checked(buf, sizeof(buf), &info);
			assert_documented(ret, "mutated wav_ffmpeg");

			if (ret == 0) {
				assert_info_sane(&info, (uint32_t)sizeof(buf));
			}
		}
	}
}
```

## src/fixtures.h
```c
/*
 * Copyright (c) 2026 Ugo Marchand
 *
 * SPDX-License-Identifier: Apache-2.0
 */

/*
 * Hand-built RIFF/WAVE containers.
 *
 * They are byte arrays rather than real .wav files because the compliance checks refuse
 * binary files in tree, and because a hostile container cannot be produced by an encoder in
 * the first place.
 */

#ifndef ZEPHYR_TESTS_LIB_WAV_FIXTURES_H_
#define ZEPHYR_TESTS_LIB_WAV_FIXTURES_H_

#include <errno.h>
#include <stddef.h>
#include <stdint.h>

#include <zephyr/audio/wav.h>

/* clang-format off */

#define LE16(v) (uint8_t)((v) & 0xFFU), (uint8_t)(((v) >> 8) & 0xFFU)

#define LE32(v)								\
	(uint8_t)((v) & 0xFFU), (uint8_t)(((v) >> 8) & 0xFFU),		\
	(uint8_t)(((v) >> 16) & 0xFFU), (uint8_t)(((v) >> 24) & 0xFFU)

#define FOURCC(a, b, c, d) (uint8_t)(a), (uint8_t)(b), (uint8_t)(c), (uint8_t)(d)

#define CHUNK_HEADER(a, b, c, d, size) FOURCC(a, b, c, d), LE32(size)

#define RIFF_WAVE(size) CHUNK_HEADER('R', 'I', 'F', 'F', size), FOURCC('W', 'A', 'V', 'E')

/** A 16-byte `fmt ` chunk, the flavour every encoder writes for integer PCM. */
#define FMT_PCM(ch, rate, bits)                                                                    \
	CHUNK_HEADER('f', 'm', 't', ' ', 16),                                                      \
	LE16(WAV_FORMAT_PCM), LE16(ch), LE32(rate),                                                \
	LE32((rate) * (ch) * ((bits) / 8)), LE16((ch) * ((bits) / 8)), LE16(bits)

/** As FMT_PCM(), with the format tag left free so a rejection can be provoked. */
#define FMT_TAG(tag, ch, rate, bits)                                                               \
	CHUNK_HEADER('f', 'm', 't', ' ', 16),                                                      \
	LE16(tag), LE16(ch), LE32(rate),                                                           \
	LE32((rate) * (ch) * ((bits) / 8)), LE16((ch) * ((bits) / 8)), LE16(bits)

/** KSDATAFORMAT_SUBTYPE_* GUID, whose first field is the effective format tag. */
#define SUBFORMAT_GUID(tag)                                                                        \
	LE32(tag), LE16(0x0000), LE16(0x0010),                                                     \
	0x80, 0x00, 0x00, 0xAA, 0x00, 0x38, 0x9B, 0x71

/** The 40-byte `WAVE_FORMAT_EXTENSIBLE` flavour, used by most >16-bit and >2-channel files. */
#define FMT_EXTENSIBLE(sub, ch, rate, bits)                                                        \
	CHUNK_HEADER('f', 'm', 't', ' ', 40),                                                      \
	LE16(WAV_FORMAT_EXTENSIBLE), LE16(ch), LE32(rate),                                         \
	LE32((rate) * (ch) * ((bits) / 8)), LE16((ch) * ((bits) / 8)), LE16(bits),                 \
	LE16(22), LE16(bits), LE32(0x0000003F), SUBFORMAT_GUID(sub)

#define EIGHT_BYTES 0x00, 0x11, 0x22, 0x33, 0x44, 0x55, 0x66, 0x77

/* Well-formed containers. Each one also has to survive being read back from a file. */

/** The textbook layout, and the only one where the payload really does start at offset 44. */
static const uint8_t wav_canonical[] = {
	RIFF_WAVE(44),
	FMT_PCM(1, 16000, 16),
	CHUNK_HEADER('d', 'a', 't', 'a', 8),
	EIGHT_BYTES,
};

/**
 * What ffmpeg actually writes: a LIST/INFO chunk sits between the format and the payload, so
 * the payload starts at offset 108. Assuming 44 is the mistake this library exists to stop.
 */
static const uint8_t wav_ffmpeg[] = {
	RIFF_WAVE(108),
	FMT_PCM(1, 16000, 16),
	CHUNK_HEADER('L', 'I', 'S', 'T', 56),
	FOURCC('I', 'N', 'F', 'O'),
	CHUNK_HEADER('I', 'S', 'F', 'T', 44),
	'L', 'a', 'v', 'f', '6', '1', '.', '7', '.', '1', '0', '0',
	0, 0, 0, 0, 0, 0, 0, 0, 0, 0, 0, 0, 0, 0, 0, 0,
	0, 0, 0, 0, 0, 0, 0, 0, 0, 0, 0, 0, 0, 0, 0, 0,
	CHUNK_HEADER('d', 'a', 't', 'a', 8),
	EIGHT_BYTES,
};

static const uint8_t wav_stereo[] = {
	RIFF_WAVE(44),
	FMT_PCM(2, 22050, 16),
	CHUNK_HEADER('d', 'a', 't', 'a', 8),
	EIGHT_BYTES,
};

/** A chunk of odd length, so the walk has to step over the pad byte that follows it. */
static const uint8_t wav_odd_pad[] = {
	RIFF_WAVE(44),
	FMT_PCM(1, 8000, 8),
	CHUNK_HEADER('j', 'u', 'n', 'k', 3),
	0xAA, 0xBB, 0xCC, 0x00,
	CHUNK_HEADER('d', 'a', 't', 'a', 8),
	EIGHT_BYTES,
};

/** An 18-byte `fmt ` chunk: legal, and two bytes longer than the one everybody expects. */
static const uint8_t wav_fmt18[] = {
	RIFF_WAVE(46),
	CHUNK_HEADER('f', 'm', 't', ' ', 18),
	LE16(WAV_FORMAT_PCM), LE16(1), LE32(44100), LE32(88200), LE16(2), LE16(16),
	LE16(0),
	CHUNK_HEADER('d', 'a', 't', 'a', 8),
	EIGHT_BYTES,
};

/** 24-bit six-channel, which is only expressible through a SubFormat GUID. */
static const uint8_t wav_extensible[] = {
	RIFF_WAVE(68),
	FMT_EXTENSIBLE(WAV_FORMAT_PCM, 6, 48000, 24),
	CHUNK_HEADER('d', 'a', 't', 'a', 36),
	EIGHT_BYTES, EIGHT_BYTES, EIGHT_BYTES, EIGHT_BYTES, 0x88, 0x99, 0xAA, 0xBB,
};

static const uint8_t wav_float32[] = {
	RIFF_WAVE(44),
	FMT_TAG(WAV_FORMAT_IEEE_FLOAT, 2, 48000, 32),
	CHUNK_HEADER('d', 'a', 't', 'a', 8),
	EIGHT_BYTES,
};

static const uint8_t wav_mulaw[] = {
	RIFF_WAVE(44),
	FMT_TAG(WAV_FORMAT_MULAW, 1, 8000, 8),
	CHUNK_HEADER('d', 'a', 't', 'a', 8),
	EIGHT_BYTES,
};

static const uint8_t wav_alaw[] = {
	RIFF_WAVE(44),
	FMT_TAG(WAV_FORMAT_ALAW, 1, 8000, 8),
	CHUNK_HEADER('d', 'a', 't', 'a', 8),
	EIGHT_BYTES,
};

/** Nothing says the format has to come first. */
static const uint8_t wav_data_first[] = {
	RIFF_WAVE(44),
	CHUNK_HEADER('d', 'a', 't', 'a', 8),
	EIGHT_BYTES,
	FMT_PCM(1, 16000, 16),
};

/** Chunks after the payload, which the walk must never reach. */
static const uint8_t wav_trailing[] = {
	RIFF_WAVE(64),
	FMT_PCM(1, 16000, 16),
	CHUNK_HEADER('d', 'a', 't', 'a', 8),
	EIGHT_BYTES,
	CHUNK_HEADER('L', 'I', 'S', 'T', 4),
	FOURCC('I', 'N', 'F', 'O'),
};

/** A header with no audio behind it: valid, and worth one millisecond of nothing. */
static const uint8_t wav_empty_data[] = {
	RIFF_WAVE(36),
	FMT_PCM(1, 16000, 16),
	CHUNK_HEADER('d', 'a', 't', 'a', 0),
};

/**
 * A payload size of 0xFFFFFFFF, as written by anything streaming to a pipe that cannot seek
 * back to patch the header. Has to be clamped, not refused.
 */
static const uint8_t wav_data_unbounded[] = {
	RIFF_WAVE(0xFFFFFFFF),
	FMT_PCM(1, 16000, 16),
	CHUNK_HEADER('d', 'a', 't', 'a', 0xFFFFFFFF),
	EIGHT_BYTES,
};

/* Containers that must be refused. Every one of these is also fed to the byte source that
 * asserts on out-of-range reads, and to the differential sweep.
 */

static const uint8_t wav_riffx[] = {
	CHUNK_HEADER('R', 'I', 'F', 'X', 44),
	FOURCC('W', 'A', 'V', 'E'),
	FMT_PCM(1, 16000, 16),
	CHUNK_HEADER('d', 'a', 't', 'a', 8),
	EIGHT_BYTES,
};

static const uint8_t wav_avi[] = {
	CHUNK_HEADER('R', 'I', 'F', 'F', 44),
	FOURCC('A', 'V', 'I', ' '),
	FMT_PCM(1, 16000, 16),
	CHUNK_HEADER('d', 'a', 't', 'a', 8),
	EIGHT_BYTES,
};

/** Exactly the preamble, and not one chunk. */
static const uint8_t wav_preamble_only[] = {
	RIFF_WAVE(4),
};

static const uint8_t wav_no_data[] = {
	RIFF_WAVE(36),
	FMT_PCM(1, 16000, 16),
};

static const uint8_t wav_no_fmt[] = {
	RIFF_WAVE(28),
	CHUNK_HEADER('L', 'I', 'S', 'T', 4),
	FOURCC('I', 'N', 'F', 'O'),
	CHUNK_HEADER('d', 'a', 't', 'a', 8),
	EIGHT_BYTES,
};

/** A `fmt ` chunk declaring sixteen bytes with eight left in the container. */
static const uint8_t wav_fmt_truncated[] = {
	RIFF_WAVE(24),
	CHUNK_HEADER('f', 'm', 't', ' ', 16),
	LE16(WAV_FORMAT_PCM), LE16(1), LE32(16000),
};

/** A non-payload chunk claiming the whole address space: clamped, and then nothing follows. */
static const uint8_t wav_chunk_unbounded[] = {
	RIFF_WAVE(0xFFFFFFFF),
	CHUNK_HEADER('L', 'I', 'S', 'T', 0xFFFFFFFF),
	FMT_PCM(1, 16000, 16),
	CHUNK_HEADER('d', 'a', 't', 'a', 8),
	EIGHT_BYTES,
};

/**
 * A chunk size picked so that adding it to the body offset wraps a 32-bit unsigned. Clamping
 * before that addition is the whole reason this parses to a plain error instead of reading
 * from a small offset it was never pointed at.
 */
static const uint8_t wav_size_wraps[] = {
	RIFF_WAVE(44),
	CHUNK_HEADER('L', 'I', 'S', 'T', 0xFFFFFFF8),
	FMT_PCM(1, 16000, 16),
	CHUNK_HEADER('d', 'a', 't', 'a', 8),
	EIGHT_BYTES,
};

static const uint8_t wav_zero_channels[] = {
	RIFF_WAVE(44),
	CHUNK_HEADER('f', 'm', 't', ' ', 16),
	LE16(WAV_FORMAT_PCM), LE16(0), LE32(16000), LE32(32000), LE16(2), LE16(16),
	CHUNK_HEADER('d', 'a', 't', 'a', 8),
	EIGHT_BYTES,
};

static const uint8_t wav_zero_rate[] = {
	RIFF_WAVE(44),
	FMT_PCM(1, 0, 16),
	CHUNK_HEADER('d', 'a', 't', 'a', 8),
	EIGHT_BYTES,
};

static const uint8_t wav_zero_bits[] = {
	RIFF_WAVE(44),
	CHUNK_HEADER('f', 'm', 't', ' ', 16),
	LE16(WAV_FORMAT_PCM), LE16(1), LE32(16000), LE32(32000), LE16(2), LE16(0),
	CHUNK_HEADER('d', 'a', 't', 'a', 8),
	EIGHT_BYTES,
};

/** Twelve bits per sample: a real thing in the wild, and not a whole number of bytes. */
static const uint8_t wav_bits12[] = {
	RIFF_WAVE(44),
	CHUNK_HEADER('f', 'm', 't', ' ', 16),
	LE16(WAV_FORMAT_PCM), LE16(1), LE32(16000), LE32(24000), LE16(2), LE16(12),
	CHUNK_HEADER('d', 'a', 't', 'a', 8),
	EIGHT_BYTES,
};

static const uint8_t wav_bits128[] = {
	RIFF_WAVE(44),
	CHUNK_HEADER('f', 'm', 't', ' ', 16),
	LE16(WAV_FORMAT_PCM), LE16(1), LE32(16000), LE32(256000), LE16(16), LE16(128),
	CHUNK_HEADER('d', 'a', 't', 'a', 8),
	EIGHT_BYTES,
};

/** IMA ADPCM: a valid format, but its payload is not an array of fixed-size frames. */
static const uint8_t wav_adpcm[] = {
	RIFF_WAVE(44),
	CHUNK_HEADER('f', 'm', 't', ' ', 16),
	LE16(0x0011), LE16(1), LE32(16000), LE32(8000), LE16(256), LE16(4),
	CHUNK_HEADER('d', 'a', 't', 'a', 8),
	EIGHT_BYTES,
};

/** MP3 wrapped in a RIFF container. */
static const uint8_t wav_mp3[] = {
	RIFF_WAVE(44),
	FMT_TAG(0x0055, 2, 44100, 16),
	CHUNK_HEADER('d', 'a', 't', 'a', 8),
	EIGHT_BYTES,
};

/** `WAVE_FORMAT_EXTENSIBLE` in a 16-byte chunk, so the GUID that defines it is missing. */
static const uint8_t wav_extensible_no_guid[] = {
	RIFF_WAVE(44),
	FMT_TAG(WAV_FORMAT_EXTENSIBLE, 2, 48000, 16),
	CHUNK_HEADER('d', 'a', 't', 'a', 8),
	EIGHT_BYTES,
};

/** A GUID resolving to a format that is not a flat array of frames. */
static const uint8_t wav_extensible_adpcm[] = {
	RIFF_WAVE(68),
	FMT_EXTENSIBLE(0x0011, 2, 16000, 16),
	CHUNK_HEADER('d', 'a', 't', 'a', 8),
	EIGHT_BYTES,
};

/* clang-format on */

struct wav_fixture {
	const char *name;
	const uint8_t *buf;
	size_t size;
	/** What wav_parse() must return for it. */
	int expected;
};

#define FIXTURE(sym, ret)                                                                          \
	{                                                                                          \
		.name = #sym,                                                                      \
		.buf = sym,                                                                        \
		.size = sizeof(sym),                                                               \
		.expected = (ret),                                                                 \
	}

/**
 * Every container above, and what it parses to.
 *
 * Driven over by the differential sweep and by the file system equivalence suite, so that
 * both of those grow automatically whenever a container is added here.
 */
static const struct wav_fixture wav_fixtures[] = {
	FIXTURE(wav_canonical, 0),
	FIXTURE(wav_ffmpeg, 0),
	FIXTURE(wav_stereo, 0),
	FIXTURE(wav_odd_pad, 0),
	FIXTURE(wav_fmt18, 0),
	FIXTURE(wav_extensible, 0),
	FIXTURE(wav_float32, 0),
	FIXTURE(wav_mulaw, 0),
	FIXTURE(wav_alaw, 0),
	FIXTURE(wav_data_first, 0),
	FIXTURE(wav_trailing, 0),
	FIXTURE(wav_empty_data, 0),
	FIXTURE(wav_data_unbounded, 0),
	FIXTURE(wav_riffx, -EINVAL),
	FIXTURE(wav_avi, -EINVAL),
	FIXTURE(wav_preamble_only, -ENOENT),
	FIXTURE(wav_no_data, -ENOENT),
	FIXTURE(wav_no_fmt, -ENOENT),
	FIXTURE(wav_fmt_truncated, -EINVAL),
	FIXTURE(wav_chunk_unbounded, -ENOENT),
	FIXTURE(wav_size_wraps, -ENOENT),
	FIXTURE(wav_zero_channels, -EINVAL),
	FIXTURE(wav_zero_rate, -EINVAL),
	FIXTURE(wav_zero_bits, -EINVAL),
	FIXTURE(wav_bits12, -EINVAL),
	FIXTURE(wav_bits128, -EINVAL),
	FIXTURE(wav_adpcm, -ENOTSUP),
	FIXTURE(wav_mp3, -ENOTSUP),
	FIXTURE(wav_extensible_no_guid, -EINVAL),
	FIXTURE(wav_extensible_adpcm, -ENOTSUP),
};

#endif /* ZEPHYR_TESTS_LIB_WAV_FIXTURES_H_ */
```

## src/fs.c
```c
/*
 * Copyright (c) 2026 Ugo Marchand
 *
 * SPDX-License-Identifier: Apache-2.0
 */

/*
 * The point of putting a callback between the parser and the bytes is that a container in
 * flash and a container in a file take the same code path. This asserts exactly that: every
 * fixture, well formed and hostile alike, is written to a file and has to parse to the same
 * result and hand back the same payload as it does from memory.
 */

#include <zephyr/kernel.h>

#ifdef CONFIG_WAV_FS

#include <errno.h>
#include <stdint.h>

#include <zephyr/audio/wav.h>
#include <zephyr/fs/fs.h>
#include <zephyr/fs/littlefs.h>
#include <zephyr/storage/flash_map.h>
#include <zephyr/sys/util.h>
#include <zephyr/ztest.h>

#include "fixtures.h"

FS_LITTLEFS_DECLARE_DEFAULT_CONFIG(storage);

#define MOUNT_POINT "/lfs"
#define CLIP_PATH   MOUNT_POINT "/clip.wav"

static struct fs_mount_t mnt = {
	.type = FS_LITTLEFS,
	.fs_data = &storage,
	.storage_dev = (void *)PARTITION_ID(storage_partition),
	.mnt_point = MOUNT_POINT,
};

static void *wav_fs_setup(void)
{
	zassert_ok(fs_mkfs(FS_LITTLEFS, (uintptr_t)mnt.storage_dev, &storage, 0),
		   "could not format the test partition");
	zassert_ok(fs_mount(&mnt), "could not mount the test partition");

	return NULL;
}

static void wav_fs_teardown(void *unused)
{
	ARG_UNUSED(unused);

	(void)fs_unmount(&mnt);
}

static void write_clip(const uint8_t *buf, size_t size, const char *name)
{
	struct fs_file_t file;
	ssize_t written;

	fs_file_t_init(&file);

	zassert_ok(fs_open(&file, CLIP_PATH, FS_O_CREATE | FS_O_WRITE | FS_O_TRUNC), "%s", name);

	written = (size > 0U) ? fs_write(&file, buf, size) : 0;
	zassert_equal(written, (ssize_t)size, "%s: wrote %zd of %zu B", name, written, size);

	zassert_ok(fs_close(&file), "%s", name);
}

static void assert_same_info(const struct wav_info *a, const struct wav_info *b, const char *name)
{
	zassert_equal(a->format, b->format, "%s: format", name);
	zassert_equal(a->num_channels, b->num_channels, "%s: channel count", name);
	zassert_equal(a->sample_rate, b->sample_rate, "%s: sample rate", name);
	zassert_equal(a->bits_per_sample, b->bits_per_sample, "%s: sample width", name);
	zassert_equal(a->data_off, b->data_off, "%s: payload offset", name);
	zassert_equal(a->data_len, b->data_len, "%s: payload length", name);
}

ZTEST_SUITE(wav_fs, NULL, wav_fs_setup, NULL, NULL, wav_fs_teardown);

ZTEST(wav_fs, test_file_and_memory_agree)
{
	ARRAY_FOR_EACH_PTR(wav_fixtures, f) {
		struct wav_source mem_src;
		struct wav_source fs_src;
		struct wav_info mem_info;
		struct wav_info fs_info;
		struct fs_file_t file;
		int mem_ret;
		int fs_ret;

		write_clip(f->buf, f->size, f->name);

		zassert_ok(wav_source_mem_init(&mem_src, f->buf, f->size), "%s", f->name);
		mem_ret = wav_parse(&mem_src, &mem_info);
		zassert_equal(mem_ret, f->expected, "%s: memory source gave %d", f->name, mem_ret);

		fs_file_t_init(&file);
		zassert_ok(fs_open(&file, CLIP_PATH, FS_O_READ), "%s", f->name);
		zassert_ok(wav_source_fs_init(&fs_src, &file), "%s", f->name);
		zassert_equal(fs_src.size, (uint32_t)f->size, "%s: file measured %u B, not %zu",
			      f->name, fs_src.size, f->size);

		fs_ret = wav_parse(&fs_src, &fs_info);
		zassert_equal(fs_ret, mem_ret, "%s: from a file %d, from memory %d", f->name,
			      fs_ret, mem_ret);

		if (fs_ret == 0) {
			uint32_t off = 0;

			assert_same_info(&fs_info, &mem_info, f->name);

			/* And the payload itself, block by block, to the very last byte. */
			while (true) {
				uint8_t from_file[16];
				uint8_t from_memory[16];
				ssize_t got_file = wav_read(&fs_src, &fs_info, off, from_file,
							    sizeof(from_file));
				ssize_t got_memory = wav_read(&mem_src, &mem_info, off, from_memory,
							      sizeof(from_memory));

				zassert_equal(got_file, got_memory,
					      "%s: at +%u a file gave %zd, memory gave %zd",
					      f->name, off, got_file, got_memory);
				zassert_true(got_file >= 0, "%s: wav_read() failed with %zd",
					     f->name, got_file);

				if (got_file == 0) {
					break;
				}

				zassert_mem_equal(from_file, from_memory, (size_t)got_file,
						  "%s: payload differs at +%u", f->name, off);
				off += (uint32_t)got_file;
			}

			zassert_equal(off, fs_info.data_len, "%s: short payload", f->name);
		}

		zassert_ok(fs_close(&file), "%s", f->name);
	}
}

ZTEST(wav_fs, test_short_file)
{
	static const uint8_t five_bytes[] = {'R', 'I', 'F', 'F', 0};
	struct wav_source src;
	struct fs_file_t file;

	write_clip(five_bytes, sizeof(five_bytes), "five_bytes");

	fs_file_t_init(&file);
	zassert_ok(fs_open(&file, CLIP_PATH, FS_O_READ));
	zassert_ok(wav_source_fs_init(&src, &file));
	zassert_equal(src.size, 5);
	zassert_equal(wav_parse(&src, NULL), -EINVAL);
	zassert_ok(fs_close(&file));
}

ZTEST(wav_fs, test_unopened_file)
{
	struct wav_source src;
	struct fs_file_t file;

	fs_file_t_init(&file);

	/* Whatever the file system makes of this, it has to be an error rather than a source
	 * that looks usable.
	 */
	zassert_true(wav_source_fs_init(&src, &file) < 0, "an unopened file was accepted");
}

ZTEST(wav_fs, test_null_arguments)
{
	struct wav_source src;
	struct fs_file_t file;

	fs_file_t_init(&file);

	zassert_equal(wav_source_fs_init(NULL, &file), -EINVAL);
	zassert_equal(wav_source_fs_init(&src, NULL), -EINVAL);
}

#endif /* CONFIG_WAV_FS */
```
