## drivers/dma/Kconfig.sam_xdmac
```kconfig
# Atmel XDMAC SAM driver configuration options

# Copyright (c) 2017 Piotr Mienkowski
# SPDX-License-Identifier: Apache-2.0

config DMA_SAM_XDMAC
	bool "Atmel SAM DMA (XDMAC) driver"
	default y
	depends on DT_HAS_ATMEL_SAM_XDMAC_ENABLED
	help
	  Enable Atmel SAM MCU Family Direct Memory Access (XDMAC) driver.

if DMA_SAM_XDMAC

config DMA_SAM_XDMAC_LLI_QUEUE_SIZE
	int "Cyclic transfer descriptor queue size"
	default 5 if I2S_SAM_SSC
	default 2
	range 2 32
	help
	  Number of linked-list descriptors reserved per channel for cyclic
	  transfers. One slot is always the closing descriptor, so at most
	  this value minus one blocks can be in flight.

endif # DMA_SAM_XDMAC
```

## lib/wav/Kconfig
```kconfig
# Copyright (c) 2026 Ugo Marchand
#
# SPDX-License-Identifier: Apache-2.0

menuconfig WAV
	bool "RIFF/WAVE (.wav) container parser"
	help
	  Enable the WAV container parser: reads the sample format out of a
	  .wav header and locates its audio payload. It does not decode,
	  convert or play anything, and does not depend on any driver.

if WAV

config WAV_MAX_CHUNKS
	int "Maximum number of RIFF chunks to inspect"
	default 16
	range 2 1024
	help
	  Give up with -E2BIG once this many chunks have been walked without
	  finding both the format and the audio payload. Bounds the work a
	  corrupt or hostile container can cause. Files written by common
	  encoders hold no more than a handful of chunks.

module = WAV
module-str = wav
source "subsys/logging/Kconfig.template.log_config"

endif # WAV
```

## subsys/mpipe/audio/Kconfig
```kconfig
#
# SPDX-FileCopyrightText: Copyright The Zephyr Project Contributors
# SPDX-License-Identifier: Apache-2.0
#

config MPIPE_AUDIO
	bool "Audio elements"
	depends on AUDIO_CODEC
	help
	  Elements bridging a pipeline to the audio drivers: a sink playing
	  PCM buffers through a Zephyr audio codec device.

if MPIPE_AUDIO

config MPIPE_AUDIO_DAC_SINK
	bool "Audio codec sink element"
	help
	  Enable the dac_sink element which writes the PCM buffers reaching
	  the end of a pipeline to an audio codec device. The codec paces
	  the stream, so a full codec holds the producer.

config MPIPE_AUDIO_DAC_SINK_BLOCK_SIZE
	int "Codec block size in bytes"
	range 2 32766
	default 96
	depends on MPIPE_AUDIO_DAC_SINK
	help
	  Size of one codec block, which is also the largest payload one
	  write can carry. The default holds one millisecond of mono 16-bit
	  48 kHz audio, matching one USB isochronous packet.

config MPIPE_AUDIO_DAC_SINK_TIMEOUT_MS
	int "How long to wait for a free codec block"
	range 1 10000
	default 100
	depends on MPIPE_AUDIO_DAC_SINK
	help
	  A buffer whose block does not come free within this delay is
	  dropped rather than held, which keeps a stopped codec from
	  blocking the pipeline thread for good.

endif # MPIPE_AUDIO
```
